## boards/shields/arca_v5/Kconfig.shield
```kconfig
config SHIELD_ARCA_V5_LEFT
	def_bool $(shields_list_contains,arca_v5_left)

config SHIELD_ARCA_V5_RIGHT
	def_bool $(shields_list_contains,arca_v5_right)
```

## config/west.yml
```yaml
# ZMK (cormoran/zmk main+dya, Zephyr 4.1) and modules, pinned to the commits used for the released firmware.
# Zephyr is pinned to its upstream base; patches/zephyr-arca.patch is applied on top (.github/workflows/build.yml).
manifest:
  version: 1.2
  defaults:
    remote: cormoran
    revision: main
  remotes:
    - name: cormoran
      url-base: https://github.com/cormoran
    - name: zmkfirmware
      url-base: https://github.com/zmkfirmware
    - name: sekigon-gonnoc
      url-base: https://github.com/sekigon-gonnoc
    # Prospector を**表示専用のBLEスキャナ**として使うためのフォーク（t-ogura）。
    # 本家 carrefinho はドングル=central前提だが、こちらは Scanner Mode を持つ
    # ＝ Arca は自分の central のまま、状態をアドバタイズするだけ
    - name: prospector
      url-base: https://github.com/t-ogura
  projects:
    - name: zmk-west-commands
      revision: 536260056f362edb2092905f2a75317bc8cb9bc2
      import: true
    - name: zmk
      revision: e5c9b6915b56801193e359dd9bad4a167ce0d1b8
      import:
        file: app/west.yml
      clone-depth: 1
    - name: zephyr
      revision: 7c6b4cc486ecb41a68d9c2b1def2bb3178fbb826
      clone-depth: 1
      import:
        name-blocklist:
          - ci-tools
          - hal_altera
          - hal_cypress
          - hal_infineon
          - hal_microchip
          - hal_nxp
          - hal_openisa
          - hal_silabs
          - hal_xtensa
          - hal_st
          - hal_ti
          - loramac-node
          - mcuboot
          - mcumgr
          - net-tools
          - openthread
          - edtt
          - trusted-firmware-m
    # ---- Arca: センサは PAW3222（DYA Dash の PMW3610 は入れない） ----
    # ---- Arca rev.2（v5・シールド arca_v5）: センサは PMW3610 ----
    #   ★2026-10-28: DYA Dash と同じドライバ（DT の compatible は "cormoran,pmw3610"）。
    #   cpi・軸・force-awake を DYA で実行時に変えられる。rev3（ark）は DT に無いので無効のまま。
    #   ★作者の注記「動作検証中」＝main 生追従はやめて固定（ZMK e5c9b69・custom-settings c6a7fef と同時期）
    - name: zmk-driver-pmw3610-with-custom-studio-rpc
      revision: 5c34ea0eec246a1c986111417cd779b53144629a
    # ---- 以下 DYA Studio の機能ページ（cormoran の現行セット） ----
    - name: zmk-feature-os-detection
      revision: 3052679f645b8fc1997275c2eaa6b86bdd55ca01
    - name: zmk-feature-default-layer
      revision: b25cb5b324da2d9bbc84e1877c775f5b2b7c6845
      import: true
    - name: zmk-driver-animation
      revision: fa0479ec3b2fe04a96d9244e620d3c5dd2cfb280
    - name: zmk-driver-ext-power-transient
      revision: 92b00e3acb438df77c374a2f79857a8406c41bed
    - name: zmk-module-ble-management
      revision: 57738cc4fc6ba80e82a7ac57741a0339cb186cd4
    - name: zmk-module-battery-history
      revision: 307755dd2ad4d320e14de162e8e5ef018f29d929
    - name: zmk-module-runtime-input-processor
      revision: 43618985f8c9d5457cc333b7ca0733f2d361911e
    - name: zmk-behavior-runtime-sensor-rotate
      revision: 21236081f8e7d1a5699248d17ff6ffd8ec1d2c20
    - name: zmk-module-settings-rpc
      revision: 78f86df9e6c5edaf57bef3ccbd7f360cfdf49291
    - name: zmk-feature-input-stream
      revision: aeb015908a42a7615ccdccc7feb3a10d23132a71
    - name: zmk-feature-module-physical-layout
      revision: 4f18de45dc27820725d267916b4cdacc0e0b6cf9
    - name: zmk-feature-custom-settings
      revision: c6a7fef3a3be3d3ace5de9a4b0628c6418cd1f3f
    - name: zmk-feature-runtime-combo
      revision: d9490e7b5d41c516221d131241009e81740efcee
    - name: zmk-feature-runtime-macro
      revision: 38530962eb7061b60efcb98e84585cfb1f0cb6de
    - name: zmk-module-devtool
      revision: 9938a2c73c06d6e65ba2c0b68c9aa044a467eafc
    - name: zmk-feature-studio-rpc-perf
      revision: b6ccb08cdc46e9e6341b0c42b97f78f05df0939e
    - name: zmk-feature-zephyr-setting-expose
      revision: 5c89bc71122840ea46032fc241bef8665b99728a
    - name: zmk-feature-device-info
      revision: 8cedd2dd9f04e19ea5a17b94914dd47a09d8db11
    - name: zmk-feature-kscan-diagnostics
      revision: 1432f7fe0cfe903cd7d3c9931ae6bd6f2e1f328e
    - name: zmk-feature-watchdog
      revision: 84ad14c6c3645dc40b23f45d08ab45418655f912
    - name: zmk-feature-fast-keymap
      revision: 8dac76de0ba38588ba39ca498910e24f8332bc6b
    - name: prospector-zmk-module
      revision: c124152f12d8c3372b1120eba05267bc7d63d06f
      remote: prospector
    # ★2026-09-29: 右TBの分割入力を16msごとにまとめる（無線時にTBが重くなる件）。
    #   GeaconPolaris で効いたもの（09-26）。Arca は ZMK main なので最新（zmk_endpoint_get_selected 版）で通る
    - name: zmk-input-processor-report-rate-limit
      revision: b056cb135525933743e2627150fb390f9d4b2461
      url: https://github.com/badjeff/zmk-input-processor-report-rate-limit
  self:
    path: config
```

## modules/arca-qscroll/Kconfig
```kconfig
DT_COMPAT_MODULA_BEHAVIOR_QUICK_SCROLL := modula,behavior-quick-scroll

config MODULA_BEHAVIOR_QUICK_SCROLL
	bool
	default $(dt_compat_enabled,$(DT_COMPAT_MODULA_BEHAVIOR_QUICK_SCROLL))

config ARCA_QSCROLL_TRACE
	bool "Arca: quick-scroll の押した/離した/捨てた/動かした量を printk する（ログ版だけ）"
	default n
```

## modules/arca-qscroll/dts/bindings/behaviors/modula,behavior-quick-scroll.yaml
```yaml
# Copyright (c) 2026
# SPDX-License-Identifier: MIT

description: Immediate scroll behavior with double-tap hold acceleration

compatible: "modula,behavior-quick-scroll"

include: two_param.yaml   # Arca: 2 つ目＝短押しで送るキー（0 で元どおり）

properties:
  x-input-code:
    type: int
    required: true
  y-input-code:
    type: int
    required: true
  trigger-period-ms:
    type: int
    default: 16
    description: The time in ms between generated inputs while held.
  delay-ms:
    type: int
    default: 0
  time-to-max-speed-ms:
    type: int
    default: 300
  acceleration-exponent:
    type: int
    default: 0
  double-tap-ms:
    type: int
    default: 200
    description: Maximum interval between release and next press to enter fast hold.
  fast-multiplier:
    type: int
    default: 8
    description: Speed multiplier for the second press and hold.
  tap-step-ms:
    type: int
    default: 80
    description: Amount of movement emitted immediately, expressed as speed over this duration.
  bounce-ms:
    type: int
    default: 0
    description: "Arca: 離してからこの間（と、別の向きを押している間）は別の向きの押下を無視する（ノブの跳ね返り）。0 で無効。"
```
